#ifndef INCLUDED_CYFITTERIAR_INC
#define INCLUDED_CYFITTERIAR_INC
    INCLUDE cydeviceiar_trm.inc

/* Pin_Sw */
Pin_Sw__0__DM__MASK EQU 0xE00000
Pin_Sw__0__DM__SHIFT EQU 21
Pin_Sw__0__DR EQU CYREG_PRT0_DR
Pin_Sw__0__HSIOM EQU CYREG_HSIOM_PORT_SEL0
Pin_Sw__0__HSIOM_MASK EQU 0xF0000000
Pin_Sw__0__HSIOM_SHIFT EQU 28
Pin_Sw__0__INTCFG EQU CYREG_PRT0_INTCFG
Pin_Sw__0__INTSTAT EQU CYREG_PRT0_INTSTAT
Pin_Sw__0__MASK EQU 0x80
Pin_Sw__0__PA__CFG0 EQU CYREG_UDB_PA0_CFG0
Pin_Sw__0__PA__CFG1 EQU CYREG_UDB_PA0_CFG1
Pin_Sw__0__PA__CFG10 EQU CYREG_UDB_PA0_CFG10
Pin_Sw__0__PA__CFG11 EQU CYREG_UDB_PA0_CFG11
Pin_Sw__0__PA__CFG12 EQU CYREG_UDB_PA0_CFG12
Pin_Sw__0__PA__CFG13 EQU CYREG_UDB_PA0_CFG13
Pin_Sw__0__PA__CFG14 EQU CYREG_UDB_PA0_CFG14
Pin_Sw__0__PA__CFG2 EQU CYREG_UDB_PA0_CFG2
Pin_Sw__0__PA__CFG3 EQU CYREG_UDB_PA0_CFG3
Pin_Sw__0__PA__CFG4 EQU CYREG_UDB_PA0_CFG4
Pin_Sw__0__PA__CFG5 EQU CYREG_UDB_PA0_CFG5
Pin_Sw__0__PA__CFG6 EQU CYREG_UDB_PA0_CFG6
Pin_Sw__0__PA__CFG7 EQU CYREG_UDB_PA0_CFG7
Pin_Sw__0__PA__CFG8 EQU CYREG_UDB_PA0_CFG8
Pin_Sw__0__PA__CFG9 EQU CYREG_UDB_PA0_CFG9
Pin_Sw__0__PC EQU CYREG_PRT0_PC
Pin_Sw__0__PC2 EQU CYREG_PRT0_PC2
Pin_Sw__0__PORT EQU 0
Pin_Sw__0__PS EQU CYREG_PRT0_PS
Pin_Sw__0__SHIFT EQU 7
Pin_Sw__DR EQU CYREG_PRT0_DR
Pin_Sw__INTCFG EQU CYREG_PRT0_INTCFG
Pin_Sw__INTSTAT EQU CYREG_PRT0_INTSTAT
Pin_Sw__MASK EQU 0x80
Pin_Sw__PA__CFG0 EQU CYREG_UDB_PA0_CFG0
Pin_Sw__PA__CFG1 EQU CYREG_UDB_PA0_CFG1
Pin_Sw__PA__CFG10 EQU CYREG_UDB_PA0_CFG10
Pin_Sw__PA__CFG11 EQU CYREG_UDB_PA0_CFG11
Pin_Sw__PA__CFG12 EQU CYREG_UDB_PA0_CFG12
Pin_Sw__PA__CFG13 EQU CYREG_UDB_PA0_CFG13
Pin_Sw__PA__CFG14 EQU CYREG_UDB_PA0_CFG14
Pin_Sw__PA__CFG2 EQU CYREG_UDB_PA0_CFG2
Pin_Sw__PA__CFG3 EQU CYREG_UDB_PA0_CFG3
Pin_Sw__PA__CFG4 EQU CYREG_UDB_PA0_CFG4
Pin_Sw__PA__CFG5 EQU CYREG_UDB_PA0_CFG5
Pin_Sw__PA__CFG6 EQU CYREG_UDB_PA0_CFG6
Pin_Sw__PA__CFG7 EQU CYREG_UDB_PA0_CFG7
Pin_Sw__PA__CFG8 EQU CYREG_UDB_PA0_CFG8
Pin_Sw__PA__CFG9 EQU CYREG_UDB_PA0_CFG9
Pin_Sw__PC EQU CYREG_PRT0_PC
Pin_Sw__PC2 EQU CYREG_PRT0_PC2
Pin_Sw__PORT EQU 0
Pin_Sw__PS EQU CYREG_PRT0_PS
Pin_Sw__SHIFT EQU 7
Pin_Sw__SNAP EQU CYREG_PRT0_INTSTAT

/* LED_Mode */
LED_Mode__0__DM__MASK EQU 0x1C0
LED_Mode__0__DM__SHIFT EQU 6
LED_Mode__0__DR EQU CYREG_PRT0_DR
LED_Mode__0__HSIOM EQU CYREG_HSIOM_PORT_SEL0
LED_Mode__0__HSIOM_MASK EQU 0x00000F00
LED_Mode__0__HSIOM_SHIFT EQU 8
LED_Mode__0__INTCFG EQU CYREG_PRT0_INTCFG
LED_Mode__0__INTSTAT EQU CYREG_PRT0_INTSTAT
LED_Mode__0__MASK EQU 0x04
LED_Mode__0__PA__CFG0 EQU CYREG_UDB_PA0_CFG0
LED_Mode__0__PA__CFG1 EQU CYREG_UDB_PA0_CFG1
LED_Mode__0__PA__CFG10 EQU CYREG_UDB_PA0_CFG10
LED_Mode__0__PA__CFG11 EQU CYREG_UDB_PA0_CFG11
LED_Mode__0__PA__CFG12 EQU CYREG_UDB_PA0_CFG12
LED_Mode__0__PA__CFG13 EQU CYREG_UDB_PA0_CFG13
LED_Mode__0__PA__CFG14 EQU CYREG_UDB_PA0_CFG14
LED_Mode__0__PA__CFG2 EQU CYREG_UDB_PA0_CFG2
LED_Mode__0__PA__CFG3 EQU CYREG_UDB_PA0_CFG3
LED_Mode__0__PA__CFG4 EQU CYREG_UDB_PA0_CFG4
LED_Mode__0__PA__CFG5 EQU CYREG_UDB_PA0_CFG5
LED_Mode__0__PA__CFG6 EQU CYREG_UDB_PA0_CFG6
LED_Mode__0__PA__CFG7 EQU CYREG_UDB_PA0_CFG7
LED_Mode__0__PA__CFG8 EQU CYREG_UDB_PA0_CFG8
LED_Mode__0__PA__CFG9 EQU CYREG_UDB_PA0_CFG9
LED_Mode__0__PC EQU CYREG_PRT0_PC
LED_Mode__0__PC2 EQU CYREG_PRT0_PC2
LED_Mode__0__PORT EQU 0
LED_Mode__0__PS EQU CYREG_PRT0_PS
LED_Mode__0__SHIFT EQU 2
LED_Mode__DR EQU CYREG_PRT0_DR
LED_Mode__INTCFG EQU CYREG_PRT0_INTCFG
LED_Mode__INTSTAT EQU CYREG_PRT0_INTSTAT
LED_Mode__MASK EQU 0x04
LED_Mode__PA__CFG0 EQU CYREG_UDB_PA0_CFG0
LED_Mode__PA__CFG1 EQU CYREG_UDB_PA0_CFG1
LED_Mode__PA__CFG10 EQU CYREG_UDB_PA0_CFG10
LED_Mode__PA__CFG11 EQU CYREG_UDB_PA0_CFG11
LED_Mode__PA__CFG12 EQU CYREG_UDB_PA0_CFG12
LED_Mode__PA__CFG13 EQU CYREG_UDB_PA0_CFG13
LED_Mode__PA__CFG14 EQU CYREG_UDB_PA0_CFG14
LED_Mode__PA__CFG2 EQU CYREG_UDB_PA0_CFG2
LED_Mode__PA__CFG3 EQU CYREG_UDB_PA0_CFG3
LED_Mode__PA__CFG4 EQU CYREG_UDB_PA0_CFG4
LED_Mode__PA__CFG5 EQU CYREG_UDB_PA0_CFG5
LED_Mode__PA__CFG6 EQU CYREG_UDB_PA0_CFG6
LED_Mode__PA__CFG7 EQU CYREG_UDB_PA0_CFG7
LED_Mode__PA__CFG8 EQU CYREG_UDB_PA0_CFG8
LED_Mode__PA__CFG9 EQU CYREG_UDB_PA0_CFG9
LED_Mode__PC EQU CYREG_PRT0_PC
LED_Mode__PC2 EQU CYREG_PRT0_PC2
LED_Mode__PORT EQU 0
LED_Mode__PS EQU CYREG_PRT0_PS
LED_Mode__SHIFT EQU 2

/* isr_GPIO */
isr_GPIO__INTC_CLR_EN_REG EQU CYREG_CM0_ICER
isr_GPIO__INTC_CLR_PD_REG EQU CYREG_CM0_ICPR
isr_GPIO__INTC_MASK EQU 0x01
isr_GPIO__INTC_NUMBER EQU 0
isr_GPIO__INTC_PRIOR_MASK EQU 0xC0
isr_GPIO__INTC_PRIOR_NUM EQU 3
isr_GPIO__INTC_PRIOR_REG EQU CYREG_CM0_IPR0
isr_GPIO__INTC_SET_EN_REG EQU CYREG_CM0_ISER
isr_GPIO__INTC_SET_PD_REG EQU CYREG_CM0_ISPR

/* LED_Status */
LED_Status__0__DM__MASK EQU 0x1C0000
LED_Status__0__DM__SHIFT EQU 18
LED_Status__0__DR EQU CYREG_PRT1_DR
LED_Status__0__HSIOM EQU CYREG_HSIOM_PORT_SEL1
LED_Status__0__HSIOM_MASK EQU 0x0F000000
LED_Status__0__HSIOM_SHIFT EQU 24
LED_Status__0__INTCFG EQU CYREG_PRT1_INTCFG
LED_Status__0__INTSTAT EQU CYREG_PRT1_INTSTAT
LED_Status__0__MASK EQU 0x40
LED_Status__0__PA__CFG0 EQU CYREG_UDB_PA1_CFG0
LED_Status__0__PA__CFG1 EQU CYREG_UDB_PA1_CFG1
LED_Status__0__PA__CFG10 EQU CYREG_UDB_PA1_CFG10
LED_Status__0__PA__CFG11 EQU CYREG_UDB_PA1_CFG11
LED_Status__0__PA__CFG12 EQU CYREG_UDB_PA1_CFG12
LED_Status__0__PA__CFG13 EQU CYREG_UDB_PA1_CFG13
LED_Status__0__PA__CFG14 EQU CYREG_UDB_PA1_CFG14
LED_Status__0__PA__CFG2 EQU CYREG_UDB_PA1_CFG2
LED_Status__0__PA__CFG3 EQU CYREG_UDB_PA1_CFG3
LED_Status__0__PA__CFG4 EQU CYREG_UDB_PA1_CFG4
LED_Status__0__PA__CFG5 EQU CYREG_UDB_PA1_CFG5
LED_Status__0__PA__CFG6 EQU CYREG_UDB_PA1_CFG6
LED_Status__0__PA__CFG7 EQU CYREG_UDB_PA1_CFG7
LED_Status__0__PA__CFG8 EQU CYREG_UDB_PA1_CFG8
LED_Status__0__PA__CFG9 EQU CYREG_UDB_PA1_CFG9
LED_Status__0__PC EQU CYREG_PRT1_PC
LED_Status__0__PC2 EQU CYREG_PRT1_PC2
LED_Status__0__PORT EQU 1
LED_Status__0__PS EQU CYREG_PRT1_PS
LED_Status__0__SHIFT EQU 6
LED_Status__DR EQU CYREG_PRT1_DR
LED_Status__INTCFG EQU CYREG_PRT1_INTCFG
LED_Status__INTSTAT EQU CYREG_PRT1_INTSTAT
LED_Status__MASK EQU 0x40
LED_Status__PA__CFG0 EQU CYREG_UDB_PA1_CFG0
LED_Status__PA__CFG1 EQU CYREG_UDB_PA1_CFG1
LED_Status__PA__CFG10 EQU CYREG_UDB_PA1_CFG10
LED_Status__PA__CFG11 EQU CYREG_UDB_PA1_CFG11
LED_Status__PA__CFG12 EQU CYREG_UDB_PA1_CFG12
LED_Status__PA__CFG13 EQU CYREG_UDB_PA1_CFG13
LED_Status__PA__CFG14 EQU CYREG_UDB_PA1_CFG14
LED_Status__PA__CFG2 EQU CYREG_UDB_PA1_CFG2
LED_Status__PA__CFG3 EQU CYREG_UDB_PA1_CFG3
LED_Status__PA__CFG4 EQU CYREG_UDB_PA1_CFG4
LED_Status__PA__CFG5 EQU CYREG_UDB_PA1_CFG5
LED_Status__PA__CFG6 EQU CYREG_UDB_PA1_CFG6
LED_Status__PA__CFG7 EQU CYREG_UDB_PA1_CFG7
LED_Status__PA__CFG8 EQU CYREG_UDB_PA1_CFG8
LED_Status__PA__CFG9 EQU CYREG_UDB_PA1_CFG9
LED_Status__PC EQU CYREG_PRT1_PC
LED_Status__PC2 EQU CYREG_PRT1_PC2
LED_Status__PORT EQU 1
LED_Status__PS EQU CYREG_PRT1_PS
LED_Status__SHIFT EQU 6

/* Miscellaneous */
CYDEV_BCLK__HFCLK__HZ EQU 24000000
CYDEV_BCLK__HFCLK__KHZ EQU 24000
CYDEV_BCLK__HFCLK__MHZ EQU 24
CYDEV_BCLK__SYSCLK__HZ EQU 24000000
CYDEV_BCLK__SYSCLK__KHZ EQU 24000
CYDEV_BCLK__SYSCLK__MHZ EQU 24
CYDEV_CHIP_DIE_LEOPARD EQU 1
CYDEV_CHIP_DIE_PSOC4A EQU 12
CYDEV_CHIP_DIE_PSOC5LP EQU 19
CYDEV_CHIP_DIE_PSOC5TM EQU 20
CYDEV_CHIP_DIE_TMA4 EQU 2
CYDEV_CHIP_DIE_UNKNOWN EQU 0
CYDEV_CHIP_FAMILY_FM0P EQU 4
CYDEV_CHIP_FAMILY_FM3 EQU 5
CYDEV_CHIP_FAMILY_FM4 EQU 6
CYDEV_CHIP_FAMILY_PSOC3 EQU 1
CYDEV_CHIP_FAMILY_PSOC4 EQU 2
CYDEV_CHIP_FAMILY_PSOC5 EQU 3
CYDEV_CHIP_FAMILY_UNKNOWN EQU 0
CYDEV_CHIP_FAMILY_USED EQU CYDEV_CHIP_FAMILY_PSOC4
CYDEV_CHIP_JTAG_ID EQU 0x04C81193
CYDEV_CHIP_MEMBER_3A EQU 1
CYDEV_CHIP_MEMBER_4A EQU 12
CYDEV_CHIP_MEMBER_4C EQU 18
CYDEV_CHIP_MEMBER_4D EQU 8
CYDEV_CHIP_MEMBER_4E EQU 4
CYDEV_CHIP_MEMBER_4F EQU 13
CYDEV_CHIP_MEMBER_4G EQU 2
CYDEV_CHIP_MEMBER_4H EQU 11
CYDEV_CHIP_MEMBER_4I EQU 17
CYDEV_CHIP_MEMBER_4J EQU 9
CYDEV_CHIP_MEMBER_4K EQU 10
CYDEV_CHIP_MEMBER_4L EQU 16
CYDEV_CHIP_MEMBER_4M EQU 15
CYDEV_CHIP_MEMBER_4N EQU 6
CYDEV_CHIP_MEMBER_4O EQU 5
CYDEV_CHIP_MEMBER_4P EQU 14
CYDEV_CHIP_MEMBER_4Q EQU 7
CYDEV_CHIP_MEMBER_4U EQU 3
CYDEV_CHIP_MEMBER_5A EQU 20
CYDEV_CHIP_MEMBER_5B EQU 19
CYDEV_CHIP_MEMBER_FM3 EQU 24
CYDEV_CHIP_MEMBER_FM4 EQU 25
CYDEV_CHIP_MEMBER_PDL_FM0P_TYPE1 EQU 21
CYDEV_CHIP_MEMBER_PDL_FM0P_TYPE2 EQU 22
CYDEV_CHIP_MEMBER_PDL_FM0P_TYPE3 EQU 23
CYDEV_CHIP_MEMBER_UNKNOWN EQU 0
CYDEV_CHIP_MEMBER_USED EQU CYDEV_CHIP_MEMBER_4A
CYDEV_CHIP_DIE_EXPECT EQU CYDEV_CHIP_MEMBER_USED
CYDEV_CHIP_DIE_ACTUAL EQU CYDEV_CHIP_DIE_EXPECT
CYDEV_CHIP_REV_LEOPARD_ES1 EQU 0
CYDEV_CHIP_REV_LEOPARD_ES2 EQU 1
CYDEV_CHIP_REV_LEOPARD_ES3 EQU 3
CYDEV_CHIP_REV_LEOPARD_PRODUCTION EQU 3
CYDEV_CHIP_REV_PSOC4A_ES0 EQU 17
CYDEV_CHIP_REV_PSOC4A_PRODUCTION EQU 17
CYDEV_CHIP_REV_PSOC5LP_ES0 EQU 0
CYDEV_CHIP_REV_PSOC5LP_PRODUCTION EQU 0
CYDEV_CHIP_REV_PSOC5TM_ES0 EQU 0
CYDEV_CHIP_REV_PSOC5TM_ES1 EQU 1
CYDEV_CHIP_REV_PSOC5TM_PRODUCTION EQU 1
CYDEV_CHIP_REV_TMA4_ES EQU 17
CYDEV_CHIP_REV_TMA4_ES2 EQU 33
CYDEV_CHIP_REV_TMA4_PRODUCTION EQU 17
CYDEV_CHIP_REVISION_3A_ES1 EQU 0
CYDEV_CHIP_REVISION_3A_ES2 EQU 1
CYDEV_CHIP_REVISION_3A_ES3 EQU 3
CYDEV_CHIP_REVISION_3A_PRODUCTION EQU 3
CYDEV_CHIP_REVISION_4A_ES0 EQU 17
CYDEV_CHIP_REVISION_4A_PRODUCTION EQU 17
CYDEV_CHIP_REVISION_4C_PRODUCTION EQU 0
CYDEV_CHIP_REVISION_4D_PRODUCTION EQU 0
CYDEV_CHIP_REVISION_4E_PRODUCTION EQU 0
CYDEV_CHIP_REVISION_4F_PRODUCTION EQU 0
CYDEV_CHIP_REVISION_4F_PRODUCTION_256DMA EQU 0
CYDEV_CHIP_REVISION_4F_PRODUCTION_256K EQU 0
CYDEV_CHIP_REVISION_4G_ES EQU 17
CYDEV_CHIP_REVISION_4G_ES2 EQU 33
CYDEV_CHIP_REVISION_4G_PRODUCTION EQU 17
CYDEV_CHIP_REVISION_4H_PRODUCTION EQU 0
CYDEV_CHIP_REVISION_4I_PRODUCTION EQU 0
CYDEV_CHIP_REVISION_4J_PRODUCTION EQU 0
CYDEV_CHIP_REVISION_4K_PRODUCTION EQU 0
CYDEV_CHIP_REVISION_4L_PRODUCTION EQU 0
CYDEV_CHIP_REVISION_4M_PRODUCTION EQU 0
CYDEV_CHIP_REVISION_4N_PRODUCTION EQU 0
CYDEV_CHIP_REVISION_4O_PRODUCTION EQU 0
CYDEV_CHIP_REVISION_4P_PRODUCTION EQU 0
CYDEV_CHIP_REVISION_4Q_PRODUCTION EQU 0
CYDEV_CHIP_REVISION_4U_PRODUCTION EQU 0
CYDEV_CHIP_REVISION_5A_ES0 EQU 0
CYDEV_CHIP_REVISION_5A_ES1 EQU 1
CYDEV_CHIP_REVISION_5A_PRODUCTION EQU 1
CYDEV_CHIP_REVISION_5B_ES0 EQU 0
CYDEV_CHIP_REVISION_5B_PRODUCTION EQU 0
CYDEV_CHIP_REVISION_FM3_PRODUCTION EQU 0
CYDEV_CHIP_REVISION_FM4_PRODUCTION EQU 0
CYDEV_CHIP_REVISION_PDL_FM0P_TYPE1_PRODUCTION EQU 0
CYDEV_CHIP_REVISION_PDL_FM0P_TYPE2_PRODUCTION EQU 0
CYDEV_CHIP_REVISION_PDL_FM0P_TYPE3_PRODUCTION EQU 0
CYDEV_CHIP_REVISION_USED EQU CYDEV_CHIP_REVISION_4A_PRODUCTION
CYDEV_CHIP_REV_EXPECT EQU CYDEV_CHIP_REVISION_USED
CYDEV_CONFIG_READ_ACCELERATOR EQU 1
CYDEV_CONFIG_UNUSED_IO_AllowButWarn EQU 0
CYDEV_CONFIG_UNUSED_IO EQU CYDEV_CONFIG_UNUSED_IO_AllowButWarn
CYDEV_CONFIG_UNUSED_IO_AllowWithInfo EQU 1
CYDEV_CONFIG_UNUSED_IO_Disallowed EQU 2
CYDEV_CONFIGURATION_COMPRESSED EQU 1
CYDEV_CONFIGURATION_MODE_COMPRESSED EQU 0
CYDEV_CONFIGURATION_MODE EQU CYDEV_CONFIGURATION_MODE_COMPRESSED
CYDEV_CONFIGURATION_MODE_DMA EQU 2
CYDEV_CONFIGURATION_MODE_UNCOMPRESSED EQU 1
CYDEV_DEBUG_PROTECT_KILL EQU 4
CYDEV_DEBUG_PROTECT_OPEN EQU 1
CYDEV_DEBUG_PROTECT EQU CYDEV_DEBUG_PROTECT_OPEN
CYDEV_DEBUG_PROTECT_PROTECTED EQU 2
CYDEV_DEBUGGING_DPS_Disable EQU 3
CYDEV_DEBUGGING_DPS_SWD EQU 2
CYDEV_DEBUGGING_DPS EQU CYDEV_DEBUGGING_DPS_SWD
CYDEV_DEBUGGING_ENABLE EQU 1
CYDEV_DFT_SELECT_CLK0 EQU 1
CYDEV_DFT_SELECT_CLK1 EQU 2
CYDEV_HEAP_SIZE EQU 0x0100
CYDEV_IMO_TRIMMED_BY_USB EQU 0
CYDEV_IMO_TRIMMED_BY_WCO EQU 0
CYDEV_IS_EXPORTING_CODE EQU 0
CYDEV_IS_IMPORTING_CODE EQU 0
CYDEV_PROJ_TYPE EQU 0
CYDEV_PROJ_TYPE_BOOTLOADER EQU 1
CYDEV_PROJ_TYPE_LAUNCHER EQU 5
CYDEV_PROJ_TYPE_LOADABLE EQU 2
CYDEV_PROJ_TYPE_LOADABLEANDBOOTLOADER EQU 4
CYDEV_PROJ_TYPE_MULTIAPPBOOTLOADER EQU 3
CYDEV_PROJ_TYPE_STANDARD EQU 0
CYDEV_STACK_SIZE EQU 0x0400
CYDEV_USE_BUNDLED_CMSIS EQU 1
CYDEV_VARIABLE_VDDA EQU 0
CYDEV_VDDA_MV EQU 5000
CYDEV_VDDD_MV EQU 5000
CYDEV_WDT_GENERATE_ISR EQU 0
CYIPBLOCK_M0S8_CTBM_VERSION EQU 0
CYIPBLOCK_m0s8cpuss_VERSION EQU 0
CYIPBLOCK_m0s8csd_VERSION EQU 0
CYIPBLOCK_m0s8gpio2_VERSION EQU 0
CYIPBLOCK_m0s8hsiom4a_VERSION EQU 0
CYIPBLOCK_m0s8lcd_VERSION EQU 0
CYIPBLOCK_m0s8lpcomp_VERSION EQU 0
CYIPBLOCK_m0s8pclk_VERSION EQU 0
CYIPBLOCK_m0s8sar_VERSION EQU 0
CYIPBLOCK_m0s8scb_VERSION EQU 0
CYIPBLOCK_m0s8srssv2_VERSION EQU 1
CYIPBLOCK_m0s8tcpwm_VERSION EQU 0
CYIPBLOCK_m0s8udbif_VERSION EQU 0
CYIPBLOCK_S8_GPIO_VERSION EQU 2
CYDEV_BOOTLOADER_ENABLE EQU 0

#endif /* INCLUDED_CYFITTERIAR_INC */
